## Kconfig
```kconfig
mainmenu "K230 SDK Configuration"


source Kconfig.board
source Kconfig.toolchain
source Kconfig.memory
source Kconfig.storage
source Kconfig.wifi

config SUPPORT_RTSMART
        bool  "support rt smart"
        default y
        help
                support rt smart;

config RTT_RUN_CORE_ID
        depends on SUPPORT_RTSMART
        int  "RTSMAR RUN core id"
        default 1
        help
           support RTTHREAD  on core num
           0--little core 800M,1----big core 1.6G


config SUPPORT_LINUX
        bool  "support linux "
        default y
        help
           support linux ;

config LINUX_RUN_CORE_ID
        depends on SUPPORT_LINUX
        int  " linux and uboot run core id"
        default 0
        help
           support linux  on core num;
           0--little core 800M,1----big core 1.6G

config MPP_MIDDLEWARE
        bool  "make mpp  middleware "
        default n
        help
           make mpp middleware ;
####################debug /realse version begain {
choice
	prompt "build debug/release version"
    default BUILD_RELEASE_VER
    help
        build debug/release version.

config BUILD_DEBUG_VER
	bool "debug"

config BUILD_RELEASE_VER
	bool "release"

endchoice


config DBGLV
        int  "config debug level"
        depends on BUILD_DEBUG_VER
        help
              debug level: 0...8 ;
              0----release
        default 0 if BUILD_RELEASE_VER
        default 8 if BUILD_DEBUG_VER
####################debug /realse version end }
```
